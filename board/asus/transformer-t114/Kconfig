## board/asus/transformer-t114/Kconfig
```kconfig
if TARGET_TRANSFORMER_T114

config SYS_BOARD
	default "transformer-t114"

config SYS_VENDOR
	default "asus"

config SYS_CONFIG_NAME
	default "transformer-t114"

endif
```

## board/microsoft/surface-2/Kconfig
```kconfig
if TARGET_SURFACE_2

config SYS_BOARD
	default "surface-2"

config SYS_VENDOR
	default "microsoft"

config SYS_CONFIG_NAME
	default "surface-2"

endif
```

## board/nvidia/tegratab/Kconfig
```kconfig
if TARGET_TEGRATAB

config SYS_BOARD
	default "tegratab"

config SYS_VENDOR
	default "nvidia"

config SYS_CONFIG_NAME
	default "tegratab"

endif
```
